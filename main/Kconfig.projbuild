## main/Kconfig.projbuild
```kconfig
menu "4G Modem Configuration"

    menu "gpio config"

        config LED_RED_SYSTEM_GPIO
            int "System status led (red) gpio, set 0 if not use"
            default 15
        config LED_BLUE_WIFI_GPIO
            int "Wi-Fi status led (blue) gpio, set 0 if not use"
            default 17
        config LED_GREEN_4GMODEM_GPIO
            int "Modem status led (green) gpio, set 0 if not use"
            default 16
        config MODEM_POWER_GPIO
            int "Modem power control gpio, set 0 if not use"
            default 12
        config MODEM_RESET_GPIO
            int "Modem reset control gpio, set 0 if not use"
            default 13
    endmenu

    menu "WiFi soft AP"

        config EXAMPLE_WIFI_SSID
            string "WiFi SSID"
            default "LTEgateway"
            help
                SSID (network name) for the example to connect to.

        config EXAMPLE_WIFI_PASSWORD
            string "WiFi Password"
            default "12345678"
            help
                WiFi password (WPA or WPA2) for the example to use.
        config EXAMPLE_WIFI_CHANNEL
            int "WiFi Channel"
            range 1 13
            default 13
            help
                WiFi channel (network channel) for the example to use.

        config EXAMPLE_MAX_STA_CONN
            int "Maximal STA connections"
            default 5
            help
                Max number of the STA connects to AP.
        config EXAMPLE_MANUAL_DNS
            bool "config main dns address"
            default n
            help
                Config main dns address manully, using dns address from ppp by default
        config EXAMPLE_MANUAL_DNS_ADDR
            string  "main dns address"
            default "114.114.114.114"
            depends on EXAMPLE_MANUAL_DNS
    endmenu

    config MODEM_DIAL_RERTY_TIMES
        int "Retry times during dial"
        default 5
        help 
            Set retry times waitting for modem link with carrier base station

    config DUMP_SYSTEM_STATUS
        bool "Dump system task status"
        default n
        help
            Dump system task status, stack left, cpu load, etc.

    config EXAMPLE_MODEM_PPP_APN
        string "Set Modem APN"
        default "internet"
        help
            Set APN (Access Point Name), a logical name to choose data network
endmenu


menu "Modbus Configuration"

    config MB_UART_PORT_NUM
        int "UART port number"
        range 0 2 if IDF_TARGET_ESP32
        default 2 if IDF_TARGET_ESP32
        range 0 1 if IDF_TARGET_ESP32S2
        default 1 if IDF_TARGET_ESP32S2
        help
            UART communication port number for Modbus.

    config MB_UART_BAUD_RATE
        int "UART communication speed"
        range 1200 115200
        default 115200
        help
            UART communication speed for Modbus.

    config MB_UART_RXD
        int "UART RXD pin number"
        range 0 34 if IDF_TARGET_ESP32
        default 22 if IDF_TARGET_ESP32
        range 0 46 if IDF_TARGET_ESP32S2
        default 19 if IDF_TARGET_ESP32S2
        help
            GPIO number for UART RX pin. See UART documentation for more information
            about available pin numbers for UART.

    config MB_UART_TXD
        int "UART TXD pin number"
        range 0 34 if IDF_TARGET_ESP32
        default 23 if IDF_TARGET_ESP32
        range 0 46 if IDF_TARGET_ESP32S2
        default 20 if IDF_TARGET_ESP32S2
        help
            GPIO number for UART TX pin. See UART documentation for more information
            about available pin numbers for UART.

    config MB_UART_RTS
        int "UART RTS pin number"
        range 0 34 if IDF_TARGET_ESP32
        range 0 46 if IDF_TARGET_ESP32S2
        default 18
        help
            GPIO number for UART RTS pin. This pin is connected to
            ~RE/DE pin of RS485 transceiver to switch direction.
            See UART documentation for more information about available pin
            numbers for UART.

    choice MB_COMM_MODE
        prompt "Modbus communication mode"
        default MB_COMM_MODE_RTU if CONFIG_FMB_COMM_MODE_RTU_EN
        help
            Selection of Modbus communication mode option for Modbus.

        config MB_COMM_MODE_RTU
            bool "RTU mode"
            depends on FMB_COMM_MODE_RTU_EN

        config MB_COMM_MODE_ASCII
            bool "ASCII mode"
            depends on FMB_COMM_MODE_ASCII_EN

    endchoice

endmenu

menu "MQTT Configuration"

    config BROKER_URI
        string "Broker URL"
        default "mqtts://mqtt.eclipseprojects.io:8883"
        help
            URL of an mqtt broker which this example connects to.

    config BROKER_CERTIFICATE_OVERRIDE
        string "Broker certificate override"
        default ""
        help
            Please leave empty if broker certificate included from a textfile; otherwise fill in a base64 part of PEM
            format certificate

    config BROKER_CERTIFICATE_OVERRIDDEN
        bool
        default y if BROKER_CERTIFICATE_OVERRIDE != ""

    config BROKER_BIN_SIZE_TO_SEND
        # This option is not visible and is used only to set parameters for example tests
        # Here we configure the data size to send and to be expected in the python script
        int
        default 20000

endmenu

menu "Ble provisionig Configuration"

    choice EXAMPLE_PROV_TRANSPORT
        bool "Provisioning Transport"
        default EXAMPLE_PROV_TRANSPORT_SOFTAP if IDF_TARGET_ESP32S2
        default EXAMPLE_PROV_TRANSPORT_BLE
        help
            Wi-Fi provisioning component offers both, SoftAP and BLE transports. Choose any one.

        config EXAMPLE_PROV_TRANSPORT_BLE
            bool "BLE"
            select BT_ENABLED
            depends on !IDF_TARGET_ESP32S2
        config EXAMPLE_PROV_TRANSPORT_SOFTAP
            bool "Soft AP"
    endchoice

    config EXAMPLE_PROV_TRANSPORT
        int
        default 1 if EXAMPLE_PROV_TRANSPORT_BLE
        default 2 if EXAMPLE_PROV_TRANSPORT_SOFTAP

    config EXAMPLE_RESET_PROVISIONED
        bool
        default n
        prompt "Reset provisioned status of the device"
        help
            This erases the NVS to reset provisioned status of the device on every reboot.
            Provisioned status is determined by the Wi-Fi STA configuration, saved on the NVS.

    config EXAMPLE_RESET_PROV_MGR_ON_FAILURE
        bool
        default y
        prompt "Reset provisioned credentials and state machine after session failure"
        help
            Enable reseting provisioned credentials and state machine after session failure.
            This will restart the provisioning service after retries are exhausted.

    config EXAMPLE_PROV_MGR_MAX_RETRY_CNT
        int
        default 5
        prompt "Max retries before reseting provisioning state machine"
        depends on EXAMPLE_RESET_PROV_MGR_ON_FAILURE
        help
            Set the Maximum retry to avoid reconnecting to an inexistent AP or if credentials
            are misconfigured. Provisioned credentials are erased and internal state machine
            is reset after this threshold is reached.


    config EXAMPLE_PROV_USING_BLUEDROID
        bool
        depends on (BT_BLUEDROID_ENABLED && (IDF_TARGET_ESP32C3 || IDF_TARGET_ESP32S3))
        select BT_BLE_42_FEATURES_SUPPORTED
        default y
        help
            This enables BLE 4.2 features for Bluedroid.
endmenu
menu "wps Configuration"

    choice EXAMPLE_WPS_TYPE
        prompt "WPS mode"
        default EXAMPLE_WPS_TYPE_PBC
        help
            WPS type for the esp32 to use.

        config EXAMPLE_WPS_TYPE_PBC
            bool "PBC"
        config EXAMPLE_WPS_TYPE_PIN
            bool "PIN"
        config EXAMPLE_WPS_TYPE_DISABLE
            bool "disable"
    endchoice

endmenu
```

## sdkconfig.defaults
```kconfig
# common wifi config
CONFIG_ESP32_WIFI_AMPDU_RX_ENABLED=n

# Override some defaults to enable PPP
CONFIG_LWIP_IPV6=n
CONFIG_LWIP_PPP_SUPPORT=y
CONFIG_LWIP_PPP_PAP_SUPPORT=y
CONFIG_LWIP_PPP_NOTIFY_PHASE_SUPPORT=y
CONFIG_LWIP_TCPIP_TASK_STACK_SIZE=4096
CONFIG_LWIP_IP4_REASSEMBLY=y
# Disable legacy API
CONFIG_MODEM_LEGACY_API=n

# Enable NAPT
CONFIG_LWIP_IP_FORWARD=y
CONFIG_LWIP_IPV4_NAPT=y
CONFIG_LWIP_IRAM_OPTIMIZATION=y

#
# Serial flasher config
#
CONFIG_ESPTOOLPY_BAUD_OTHER_VAL=115200
CONFIG_ESPTOOLPY_FLASHMODE_QIO=y
CONFIG_ESPTOOLPY_FLASHMODE="dio"
CONFIG_ESPTOOLPY_FLASHFREQ_80M=y
CONFIG_ESPTOOLPY_FLASHFREQ="80m"
CONFIG_ESPTOOLPY_FLASHSIZE_4MB=y
CONFIG_ESPTOOLPY_FLASHSIZE="4MB"
CONFIG_ESPTOOLPY_FLASHSIZE_DETECT=y

CONFIG_ESP_INT_WDT=n
CONFIG_ESP_TASK_WDT=n

CONFIG_FREERTOS_HZ=1000
CONFIG_FREERTOS_USE_TRACE_FACILITY=y
CONFIG_FREERTOS_GENERATE_RUN_TIME_STATS=y
CONFIG_FREERTOS_RUN_TIME_STATS_USING_ESP_TIMER=y

#
# Compiler options
#
CONFIG_COMPILER_OPTIMIZATION_PERF=y
CONFIG_COMPILER_OPTIMIZATION_ASSERTIONS_ENABLE=y

#
# USB Host CDC options
#
CONFIG_CDC_SEND_DTE_ACTIVE=n
CONFIG_CDC_BULK_OUT_URB_BUFFER_SIZE=1536
CONFIG_CDC_BULK_IN_URB_BUFFER_SIZE=1536
CONFIG_CDC_BULK_IN_URB_NUM=4
CONFIG_CDC_BULK_OUT_URB_NUM=4

# For debug
#CONFIG_MODEM_TARGET_EC600N_CNLC_N06=y
#CONFIG_LWIP_DEBUG=y
CONFIG_LOG_DEFAULT_LEVEL_INFO=y
#CONFIG_LOG_DEFAULT_LEVEL_NONE=y
#CONFIG_LWIP_PPP_DEBUG_ON=y
#CONFIG_EXAMPLE_WIFI_SSID="esp_4g_test"
#CONFIG_EXAMPLE_WIFI_PASSWORD="87654321"
#CONFIG_MODEM_TARGET_USER=y
#CONFIG_CDC_USE_TRACE_FACILITY=y
CONFIG_DUMP_SYSTEM_STATUS=y
#CONFIG_EXAMPLE_MANUAL_DNS=y
#CONFIG_EXAMPLE_MANUAL_DNS_ADDR="114.114.114.114"


#
# Modbus configuration
#
CONFIG_MB_UART_PORT_NUM=1
CONFIG_MB_UART_BAUD_RATE=9600
CONFIG_MB_COMM_MODE_RTU=y
CONFIG_MB_UART_TXD=13
CONFIG_MB_UART_RXD=47
CONFIG_MB_UART_RTS=14
CONFIG_FMB_TIMER_PORT_ENABLED=y
CONFIG_FMB_TIMER_GROUP=0
CONFIG_FMB_TIMER_INDEX=0
CONFIG_FMB_TIMER_ISR_IN_IRAM=y
CONFIG_FMB_MASTER_DELAY_MS_CONVERT=200
CONFIG_FMB_MASTER_TIMEOUT_MS_RESPOND=150

#
# MQTT Configuration
#
CONFIG_BROKER_URI="mqtts://mqtts.pool.mytech-connect.io:28883"
CONFIG_BROKER_CERTIFICATE_OVERRIDE=""
CONFIG_MQTT_USE_CUSTOM_CONFIG=y
CONFIG_MQTT_TCP_DEFAULT_PORT=1883
CONFIG_MQTT_SSL_DEFAULT_PORT=8883
CONFIG_MQTT_WS_DEFAULT_PORT=80
CONFIG_MQTT_WSS_DEFAULT_PORT=443
CONFIG_MQTT_BUFFER_SIZE=16384
CONFIG_MQTT_TASK_STACK_SIZE=16384

CONFIG_ESP_NETIF_TCPIP_ADAPTER_COMPATIBLE_LAYER=y

CONFIG_EXAMPLE_CONNECT_ETHERNET=y
CONFIG_EXAMPLE_CONNECT_WIFI=n
CONFIG_EXAMPLE_USE_INTERNAL_ETHERNET=y
CONFIG_EXAMPLE_ETH_PHY_IP101=y
CONFIG_EXAMPLE_ETH_MDC_GPIO=23
CONFIG_EXAMPLE_ETH_MDIO_GPIO=18
CONFIG_EXAMPLE_ETH_PHY_RST_GPIO=5
CONFIG_EXAMPLE_ETH_PHY_ADDR=1
CONFIG_EXAMPLE_CONNECT_IPV6=y

CONFIG_ESP_TLS_INSECURE=y
CONFIG_ESP_TLS_SKIP_SERVER_CERT_VERIFY=y
CONFIG_ESP_TLS_USE_DS_PERIPHERAL=n
CONFIG_ESP_TLS_CLIENT_SESSION_TICKETS=y

CONFIG_MBEDTLS_ASYMMETRIC_CONTENT_LEN=y
CONFIG_MBEDTLS_SSL_IN_CONTENT_LEN=16384
CONFIG_MBEDTLS_SSL_OUT_CONTENT_LEN=16384
CONFIG_MBEDTLS_DEBUG=n
CONFIG_MBEDTLS_ECJPAKE_C=y
CONFIG_MBEDTLS_POLY1305_C=y
CONFIG_MBEDTLS_CHACHA20_C=y
CONFIG_MBEDTLS_HKDF_C=y
CONFIG_MBEDTLS_TLS_CLIENT_ONLY=y
CONFIG_MBEDTLS_HARDWARE_MPI=n

#CONFIG_MAIN_TASK_STACK_SIZE=32768#16384
CONFIG_ESP_MAIN_TASK_STACK_SIZE=32768

CONFIG_DUMP_SYSTEM_STATUS=n

CONFIG_PARTITION_TABLE_CUSTOM=y
CONFIG_PARTITION_TABLE_CUSTOM_FILENAME="ingeli_partitions_two_ota.csv"
CONFIG_EXAMPLE_FIRMWARE_UPGRADE_URL="http://192.168.1.1:8080"
OTA_ALLOW_HTTP=y

CONFIG_EXAMPLE_MODEM_PPP_APN="iot.1nce.net"

CONFIG_MODEM_USB_OUT_EP_ADDR=0x02
CONFIG_MODEM_USB_IN_EP_ADDR=0x82
```

## sdkconfig.defaults.esp32s3
```kconfig
#
# ESP32S3-Specific
#
CONFIG_ESP32S3_DEFAULT_CPU_FREQ_240=y
CONFIG_ESP32S3_DEFAULT_CPU_FREQ_MHZ=240

CONFIG_MODEM_USB_OUT_EP_ADDR=0x02
CONFIG_MODEM_USB_IN_EP_ADDR=0x82

CONFIG_USB_TASK_CORE_ID=1

TEST_GU=1
```
